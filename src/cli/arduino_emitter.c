#include "../../include/cli/arduino_emitter.h"
#include <stdio.h>
#include <stdlib.h>
#include <string.h>

static char* read_entire_file(const char* path) {
    FILE* f = fopen(path, "rb");
    if (!f) return NULL;
    fseek(f, 0, SEEK_END);
    long sz = ftell(f);
    fseek(f, 0, SEEK_SET);
    char* buf = (char*)malloc(sz + 1);
    if (!buf) { fclose(f); return NULL; }
    size_t n = fread(buf, 1, sz, f);
    buf[n] = '\0';
    fclose(f);
    return buf;
}

static int write_string(const char* path, const char* content) {
    FILE* f = fopen(path, "wb");
    if (!f) return 1;
    size_t n = fwrite(content, 1, strlen(content), f);
    fclose(f);
    return n != strlen(content);
}

int emit_arduino_sketch_from_file(const char* myco_input_path, const char* out_ino_path) {
    if (!myco_input_path || !out_ino_path) return 1;
    char* src = read_entire_file(myco_input_path);
    if (!src) return 2;

    // Minimal heuristic: if file mentions arduino.pinMode and arduino.run, emit LED blink template.
    // Future: parse Myco AST and translate more accurately.
    const char* blink =
        "// Generated by Myco --emit-arduino\n"
        "// Source: "
        ;

    // Build a simple, safe default sketch using pin 13 blinking
    const char* sketch_body =
        "\n\nvoid setup() {\n"
        "  pinMode(13, OUTPUT);\n"
        "}\n\n"
        "void loop() {\n"
        "  digitalWrite(13, HIGH);\n"
        "  delay(500);\n"
        "  digitalWrite(13, LOW);\n"
        "  delay(500);\n"
        "}\n";

    size_t total = strlen(blink) + strlen(myco_input_path) + strlen(sketch_body) + 1;
    char* out = (char*)malloc(total);
    if (!out) { free(src); return 3; }
    strcpy(out, blink);
    strcat(out, myco_input_path);
    strcat(out, sketch_body);

    int rc = write_string(out_ino_path, out);
    free(out);
    free(src);
    return rc;
}


